## config/boards/shields/to/Kconfig.defconfig
```kconfig
# Copyright (c) 2020 The ZMK Contributors
# SPDX-License-Identifier: MIT

if SHIELD_TO_DONGLE

config ZMK_KEYBOARD_NAME
	default "to Dongle"
	
config ZMK_SPLIT_BLE_ROLE_CENTRAL
	default y
	
config ZMK_USB
	default y

endif

if SHIELD_TO_LEFT || SHIELD_TO_RIGHT || SHIELD_TO_DONGLE 

config ZMK_SPLIT
	default y

config ZMK_BLE
	default y
	
endif
```

## config/boards/shields/to/Kconfig.shield
```kconfig
# Copyright (c) 2020 The ZMK Contributors
# SPDX-License-Identifier: MIT

config SHIELD_TO_LEFT
	def_bool $(shields_list_contains,to_left)

config SHIELD_TO_RIGHT
	def_bool $(shields_list_contains,to_right)

config SHIELD_TO_DONGLE
	def_bool $(shields_list_contains,to_dongle)
```
